## apps/kit/firmware/platforms/iterate_esp_idf/components/board/Kconfig
```kconfig
config ITERATE_KIT_DIAGNOSTIC_SILENT_OUTPUT
    bool "Suppress physical speaker output for board diagnostics"
    default n
    help
        A diagnostic-only build switch. It keeps a table board's amplifier
        disabled and replaces every local or streamed PCM write with silence
        at the shared hardware boundary. I2S TX remains clocked so boards
        whose microphone DSP needs a continuous playback reference still run
        normally. Health exposes attempted and zero-written sample counters.

        Requires a table amplifier GPIO. Startup latches it off before any
        networking and accepts the OTA image immediately, so failed networking
        cannot roll back into audible firmware. Recover through OTA if still
        reachable, or explicit serial flashing; automatic rollback is disabled
        for this diagnostic image.

        This is deliberately compile-time only. Production firmware must not
        silently lose playout through a runtime mode or provider setting.
```

## apps/kit/firmware/platforms/iterate_esp_idf/components/board_wake_word/Kconfig
```kconfig
config ITERATE_KIT_WAKE_WORD
    bool
    default y
    depends on IDF_TARGET_ESP32S3
    help
        Compile the shared capture tap only when board_wake_word is present.
```

## apps/kit/firmware/targets/waveshare_s3_rlcd/sdkconfig.defaults
```kconfig
CONFIG_PARTITION_TABLE_CUSTOM_FILENAME="../common/partitions-16mb.csv"
CONFIG_ESPTOOLPY_FLASHSIZE_16MB=y
CONFIG_SPIRAM_MODE_OCT=y
CONFIG_SPIRAM_MALLOC_RESERVE_INTERNAL=65536
```

## apps/kit/firmware/targets/waveshare_s3_rlcd_hello/sdkconfig.defaults
```kconfig
CONFIG_ESPTOOLPY_FLASHSIZE_16MB=y
CONFIG_ESP_CONSOLE_USB_SERIAL_JTAG=y
CONFIG_ESP_CONSOLE_UART_DEFAULT=n
CONFIG_FREERTOS_HZ=1000
CONFIG_PARTITION_TABLE_CUSTOM=y
CONFIG_PARTITION_TABLE_CUSTOM_FILENAME="../common/partitions-16mb-4mb-app.csv"
```
